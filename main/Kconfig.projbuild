## main/Kconfig.projbuild
```kconfig
menu "WiFi Watchdog Board"

config WIFI_SSID
    string "Wifi Network Name"
    default ""
    help
        WiFi Network name

config WIFI_PSW
    string "Wifi Passowrd"
    default ""
    help 
        WiFi Network password
    
config SERVER_PORT
    int "Server listening port"
    range 49152 65535
    default 57015
    help
        The server will be listening to this port for TCP 
        connections from anchors
    
config DISCOVERY_PORT
    int "UDP Discovery Port"
    range 49152 65535
    default 57016
    help
        The server will advertise its IP through broadcast
        UDP messages to this port
    
config PACKET_DISCARD_TIME
    int "Time after which packets received are discarded (ms)"
    range 0 3600000
    default 0
    help
        If the anchor is not connected to the server, packets
        older than this time are automatically discarded.
        If 0 packets are never discarded (unless anchor memory 
        is full).

config SNTP_SYNC_INTERVAL
    int "SNTP protocol requests interval (ms)"
    range 15000 3600000
    default 30000
    help
        This interval defines the frequency with which the esp32
        anchor synchronizes its clock with the SNTP server.
        
endmenu
```

## sdkconfig.defaults
```kconfig
#
# Serial flasher config
#
CONFIG_ESPTOOLPY_PORT="COM3"
CONFIG_ESPTOOLPY_BAUD_115200B=
CONFIG_ESPTOOLPY_BAUD_230400B=
CONFIG_ESPTOOLPY_BAUD_921600B=y
CONFIG_ESPTOOLPY_BAUD=921600

#
# WiFi Watchdog Board
#
CONFIG_WIFI_SSID=""
CONFIG_WIFI_PSW=""
CONFIG_SERVER_PORT=57015
CONFIG_DISCOVERY_PORT=57016
CONFIG_PACKET_DISCARD_TIME=0
CONFIG_SNTP_SYNC_INTERVAL=30000

#
# Partition Table
#
CONFIG_PARTITION_TABLE_CUSTOM_APP_BIN_OFFSET=0x10000
CONFIG_APP_OFFSET=0x10000

#
# FreeRTOS SystemView Tracing
#
CONFIG_AWS_IOT_SDK=

#
# ESP32-specific
#
CONFIG_TASK_WDT=
CONFIG_ESP32_RTC_XTAL_BOOTSTRAP_CYCLES=100


#
# Wi-Fi
#
CONFIG_ESP32_WIFI_TASK_PINNED_TO_CORE_0=
CONFIG_ESP32_WIFI_TASK_PINNED_TO_CORE_1=y

#
# FreeRTOS
#
CONFIG_FREERTOS_IDLE_TASK_STACKSIZE=1024
CONFIG_FREERTOS_USE_TRACE_FACILITY=y
CONFIG_FREERTOS_USE_STATS_FORMATTING_FUNCTIONS=y

#
# LWIP
#
CONFIG_LWIP_ETHARP_TRUST_IP_MAC=y

#
# mDNS
#
CONFIG_MDNS_MAX_SERVICES=10
```
